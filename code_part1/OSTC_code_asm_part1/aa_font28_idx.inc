;==========================================================================
; Font index exported mar. nov. 30 2010 by FontIO.cpp 57 2010-11-24 23:24:47Z gascuel $ 
;==========================================================================
aa_font28_chars		EQU	.99
aa_font28_firstChar	EQU	'!'
aa_font28_lastChar	EQU	'ƒ'
;
aa_font28_idx:
			DW	aa_font28_bits + 0x0000	; ! mark
			DW	aa_font28_bits + 0x000E	; " dquote
			DW	aa_font28_bits + 0x001F	; # sharp
			DW	aa_font28_bits + 0x0050	; $ dolar
			DW	aa_font28_bits + 0x007D	; % percent
			DW	aa_font28_bits + 0x00C2	; & and
			DW	aa_font28_bits + 0x00FD	; ' quote
			DW	aa_font28_bits + 0x0107	; ( lparent
			DW	aa_font28_bits + 0x0124	; ) rparent
			DW	aa_font28_bits + 0x0141	; * star
			DW	aa_font28_bits + 0x0166	; + plus
			DW	aa_font28_bits + 0x017F	; , comma
			DW	aa_font28_bits + 0x018A	; - minus
			DW	aa_font28_bits + 0x019F	; . dot
			DW	aa_font28_bits + 0x01A8	; / slash
			DW	aa_font28_bits + 0x01C1	; 0 0
			DW	aa_font28_bits + 0x01E6	; 1 1
			DW	aa_font28_bits + 0x0204	; 2 2
			DW	aa_font28_bits + 0x0233	; 3 3
			DW	aa_font28_bits + 0x0262	; 4 4
			DW	aa_font28_bits + 0x0283	; 5 5
			DW	aa_font28_bits + 0x02B2	; 6 6
			DW	aa_font28_bits + 0x02E7	; 7 7
			DW	aa_font28_bits + 0x030A	; 8 8
			DW	aa_font28_bits + 0x0341	; 9 9
			DW	aa_font28_bits + 0x0376	; : colon
			DW	aa_font28_bits + 0x0384	; ; semicolon
			DW	aa_font28_bits + 0x0394	; < less
			DW	aa_font28_bits + 0x03BB	; = equal
			DW	aa_font28_bits + 0x03E8	; > greater
			DW	aa_font28_bits + 0x040F	; ? question
			DW	aa_font28_bits + 0x0434	; @ arobas
			DW	aa_font28_bits + 0x0473	; A A
			DW	aa_font28_bits + 0x0498	; B B
			DW	aa_font28_bits + 0x04CF	; C C
			DW	aa_font28_bits + 0x04FC	; D D
			DW	aa_font28_bits + 0x0521	; E E
			DW	aa_font28_bits + 0x0556	; F F
			DW	aa_font28_bits + 0x057D	; G G
			DW	aa_font28_bits + 0x05AA	; H H
			DW	aa_font28_bits + 0x05BF	; I I
			DW	aa_font28_bits + 0x05E4	; J J
			DW	aa_font28_bits + 0x05FF	; K K
			DW	aa_font28_bits + 0x0626	; L L
			DW	aa_font28_bits + 0x063B	; M M
			DW	aa_font28_bits + 0x0656	; N N
			DW	aa_font28_bits + 0x066B	; O O
			DW	aa_font28_bits + 0x0694	; P P
			DW	aa_font28_bits + 0x06B5	; Q Q
			DW	aa_font28_bits + 0x06E6	; R R
			DW	aa_font28_bits + 0x0711	; S S
			DW	aa_font28_bits + 0x0744	; T T
			DW	aa_font28_bits + 0x0761	; U U
			DW	aa_font28_bits + 0x0776	; V V
			DW	aa_font28_bits + 0x0791	; W W
			DW	aa_font28_bits + 0x07AC	; X X
			DW	aa_font28_bits + 0x07DF	; Y Y
			DW	aa_font28_bits + 0x07FC	; Z Z
			DW	aa_font28_bits + 0x0837	; [ lsqbracket
			DW	aa_font28_bits + 0x0850	; \ backslash
			DW	aa_font28_bits + 0x0869	; ] rsqbracket
			DW	aa_font28_bits + 0x0882	; ^ caret
			DW	aa_font28_bits + 0x0899	; _ underline
			DW	aa_font28_bits + 0x08B6	; ` backquote
			DW	aa_font28_bits + 0x08C1	; a a
			DW	aa_font28_bits + 0x08FA	; b b
			DW	aa_font28_bits + 0x091F	; c c
			DW	aa_font28_bits + 0x0944	; d d
			DW	aa_font28_bits + 0x0969	; e e
			DW	aa_font28_bits + 0x09A6	; f f
			DW	aa_font28_bits + 0x09CB	; g g
			DW	aa_font28_bits + 0x0A00	; h h
			DW	aa_font28_bits + 0x0A15	; i i
			DW	aa_font28_bits + 0x0A2B	; j j
			DW	aa_font28_bits + 0x0A4A	; k k
			DW	aa_font28_bits + 0x0A6D	; l l
			DW	aa_font28_bits + 0x0A7C	; m m
			DW	aa_font28_bits + 0x0A95	; n n
			DW	aa_font28_bits + 0x0AAA	; o o
			DW	aa_font28_bits + 0x0AD3	; p p
			DW	aa_font28_bits + 0x0AF8	; q q
			DW	aa_font28_bits + 0x0B1D	; r r
			DW	aa_font28_bits + 0x0B32	; s s
			DW	aa_font28_bits + 0x0B65	; t t
			DW	aa_font28_bits + 0x0B88	; u u
			DW	aa_font28_bits + 0x0B9D	; v v
			DW	aa_font28_bits + 0x0BB4	; w w
			DW	aa_font28_bits + 0x0BCF	; x x
			DW	aa_font28_bits + 0x0BFC	; y y
			DW	aa_font28_bits + 0x0C21	; z z
			DW	aa_font28_bits + 0x0C52	; { lbrace
			DW	aa_font28_bits + 0x0C77	; | bar
			DW	aa_font28_bits + 0x0C7E	; } rbrace
			DW	aa_font28_bits + 0x0CA3	; ~ tilde
			DW	aa_font28_bits + 0x0CBA	;  7F
			DW	aa_font28_bits + 0x0CDF	; € 80
			DW	aa_font28_bits + 0x0CE2	; � 81
			DW	aa_font28_bits + 0x0D09	; ‚ 82
			DW	aa_font28_bits + 0x0D22	; ƒ 83
			DW	aa_font28_bits + 0x0D53	; END OF INDEX
