;==========================================================================
; Font index exported by fontconv.php 1.00 2011-08-02 00:31:07 rvs $
;==========================================================================
aa_font28_chars		EQU	.149
aa_font28_firstChar	EQU	' '
aa_font28_lastChar	EQU	'´'
;
aa_font28_idx:
			DW	aa_font28_bits+0x0000	;   Space
			DW	aa_font28_bits+0x0003	; ! mark
			DW	aa_font28_bits+0x0011	; " dquote
			DW	aa_font28_bits+0x0022	; # sharp
			DW	aa_font28_bits+0x0053	; $ dolar
			DW	aa_font28_bits+0x0080	; % percent
			DW	aa_font28_bits+0x00C5	; & and
			DW	aa_font28_bits+0x0100	; ' quote
			DW	aa_font28_bits+0x010A	; ( lparent
			DW	aa_font28_bits+0x0127	; ) rparent
			DW	aa_font28_bits+0x0144	; * star
			DW	aa_font28_bits+0x0169	; + plus
			DW	aa_font28_bits+0x0182	; , comma
			DW	aa_font28_bits+0x018D	; - minus
			DW	aa_font28_bits+0x01A2	; . dot
			DW	aa_font28_bits+0x01AB	; / slash
			DW	aa_font28_bits+0x01C4	; 0 0
			DW	aa_font28_bits+0x01E9	; 1 1
			DW	aa_font28_bits+0x0206	; 2 2
			DW	aa_font28_bits+0x0235	; 3 3
			DW	aa_font28_bits+0x0264	; 4 4
			DW	aa_font28_bits+0x0285	; 5 5
			DW	aa_font28_bits+0x02B4	; 6 6
			DW	aa_font28_bits+0x02E9	; 7 7
			DW	aa_font28_bits+0x030C	; 8 8
			DW	aa_font28_bits+0x0343	; 9 9
			DW	aa_font28_bits+0x0378	; : colon
			DW	aa_font28_bits+0x0386	; ; semicolon
			DW	aa_font28_bits+0x0396	; < less
			DW	aa_font28_bits+0x03BD	; = equal
			DW	aa_font28_bits+0x03EA	; > greater
			DW	aa_font28_bits+0x0411	; ? question
			DW	aa_font28_bits+0x0436	; @ arobas
			DW	aa_font28_bits+0x0475	; A A
			DW	aa_font28_bits+0x049A	; B B
			DW	aa_font28_bits+0x04D1	; C C
			DW	aa_font28_bits+0x04FE	; D D
			DW	aa_font28_bits+0x0523	; E E
			DW	aa_font28_bits+0x0558	; F F
			DW	aa_font28_bits+0x057F	; G G
			DW	aa_font28_bits+0x05AC	; H H
			DW	aa_font28_bits+0x05C1	; I I
			DW	aa_font28_bits+0x05E6	; J J
			DW	aa_font28_bits+0x0601	; K K
			DW	aa_font28_bits+0x0628	; L L
			DW	aa_font28_bits+0x063D	; M M
			DW	aa_font28_bits+0x0658	; N N
			DW	aa_font28_bits+0x066D	; O O
			DW	aa_font28_bits+0x0696	; P P
			DW	aa_font28_bits+0x06B7	; Q Q
			DW	aa_font28_bits+0x06E8	; R R
			DW	aa_font28_bits+0x0713	; S S
			DW	aa_font28_bits+0x0746	; T T
			DW	aa_font28_bits+0x0763	; U U
			DW	aa_font28_bits+0x0778	; V V
			DW	aa_font28_bits+0x0793	; W W
			DW	aa_font28_bits+0x07AE	; X X
			DW	aa_font28_bits+0x07E1	; Y Y
			DW	aa_font28_bits+0x07FE	; Z Z
			DW	aa_font28_bits+0x0839	; [ lsqbracket
			DW	aa_font28_bits+0x0852	; \ backslash
			DW	aa_font28_bits+0x086B	; ] rsqbracket
			DW	aa_font28_bits+0x0884	; ^ caret
			DW	aa_font28_bits+0x089B	; _ underline
			DW	aa_font28_bits+0x08B8	; ` backquote
			DW	aa_font28_bits+0x08C3	; a a
			DW	aa_font28_bits+0x08FC	; b b
			DW	aa_font28_bits+0x0921	; c c
			DW	aa_font28_bits+0x0946	; d d
			DW	aa_font28_bits+0x096B	; e e
			DW	aa_font28_bits+0x09A8	; f f
			DW	aa_font28_bits+0x09CD	; g g
			DW	aa_font28_bits+0x0A02	; h h
			DW	aa_font28_bits+0x0A17	; i i
			DW	aa_font28_bits+0x0A2D	; j j
			DW	aa_font28_bits+0x0A4C	; k k
			DW	aa_font28_bits+0x0A6F	; l l
			DW	aa_font28_bits+0x0A7E	; m m
			DW	aa_font28_bits+0x0A97	; n n
			DW	aa_font28_bits+0x0AAC	; o o
			DW	aa_font28_bits+0x0AD5	; p p
			DW	aa_font28_bits+0x0AFA	; q q
			DW	aa_font28_bits+0x0B1F	; r r
			DW	aa_font28_bits+0x0B34	; s s
			DW	aa_font28_bits+0x0B67	; t t
			DW	aa_font28_bits+0x0B8A	; u u
			DW	aa_font28_bits+0x0B9F	; v v
			DW	aa_font28_bits+0x0BB6	; w w
			DW	aa_font28_bits+0x0BD1	; x x
			DW	aa_font28_bits+0x0BFE	; y y
			DW	aa_font28_bits+0x0C23	; z z
			DW	aa_font28_bits+0x0C54	; { lbrace
			DW	aa_font28_bits+0x0C77	; | bar
			DW	aa_font28_bits+0x0C7E	; } rbrace
			DW	aa_font28_bits+0x0CA1	; ~ tilde
			DW	aa_font28_bits+0x0CB8	; º 7F
			DW	aa_font28_bits+0x0CFD	; Á 80
			DW	aa_font28_bits+0x0D32	; Ã 81
			DW	aa_font28_bits+0x0D47	; Ä 82
			DW	aa_font28_bits+0x0D72	; Æ 83
			DW	aa_font28_bits+0x0DA1	; Ç 84
			DW	aa_font28_bits+0x0DD8	; È 85
			DW	aa_font28_bits+0x0DED	; É 86
			DW	aa_font28_bits+0x0E08	; Ë 87
			DW	aa_font28_bits+0x0E23	; Ï 88
			DW	aa_font28_bits+0x0E3A	; Ó 89
			DW	aa_font28_bits+0x0E63	; Ô 8A
			DW	aa_font28_bits+0x0E88	; Ö 8B
			DW	aa_font28_bits+0x0EA3	; × 8C
			DW	aa_font28_bits+0x0EBA	; Ø 8D
			DW	aa_font28_bits+0x0ED3	; Ù 8E
			DW	aa_font28_bits+0x0EF0	; Ú 8F
			DW	aa_font28_bits+0x0F17	; � 90
			DW	aa_font28_bits+0x0F9C	; ‘ 91
			DW	aa_font28_bits+0x0FE7	; ’ 92
			DW	aa_font28_bits+0x100C	; “ 93
			DW	aa_font28_bits+0x1023	; Û 94
			DW	aa_font28_bits+0x1048	; Ü 95
			DW	aa_font28_bits+0x1069	; Ý 96
			DW	aa_font28_bits+0x10A6	; Þ 97
			DW	aa_font28_bits+0x10CB	; ß 98
			DW	aa_font28_bits+0x10F6	; á 99
			DW	aa_font28_bits+0x1133	; â 9A
			DW	aa_font28_bits+0x1162	; ã 9B
			DW	aa_font28_bits+0x1177	; ä 9C
			DW	aa_font28_bits+0x11A0	; æ 9D
			DW	aa_font28_bits+0x11C5	; ç 9E
			DW	aa_font28_bits+0x11FA	; è 9F
			DW	aa_font28_bits+0x120F	; é A0
			DW	aa_font28_bits+0x1232	; ê A1
			DW	aa_font28_bits+0x1253	; ë A2
			DW	aa_font28_bits+0x126C	; ì A3
			DW	aa_font28_bits+0x1287	; ¤ A4
			DW	aa_font28_bits+0x12AC	; í A5
			DW	aa_font28_bits+0x12C1	; ï A6
			DW	aa_font28_bits+0x12D6	; ò A7
			DW	aa_font28_bits+0x12EF	; ô A8
			DW	aa_font28_bits+0x1314	; ö A9
			DW	aa_font28_bits+0x132D	; ÷ AA
			DW	aa_font28_bits+0x1342	; ø AB
			DW	aa_font28_bits+0x135B	; ù AC
			DW	aa_font28_bits+0x1378	; ú AD
			DW	aa_font28_bits+0x139D	; ® AE
			DW	aa_font28_bits+0x13BE	; û AF
			DW	aa_font28_bits+0x13E3	; ° B0
			DW	aa_font28_bits+0x13FC	; ü B1
			DW	aa_font28_bits+0x141D	; ý B2
			DW	aa_font28_bits+0x1450	; þ B3
			DW	aa_font28_bits+0x1475	; ÿ B4
			DW	aa_font28_bits+0x149E	; END OF INDEX
