dive_nitrox_width    equ .78
dive_nitrox_height   equ .26
dive_nitrox_block:
    db  .39, .26
    db  .9, 0
    dw  0x0000 ; rgb=(0,0,0)
    dw  0x10c0 ; rgb=(19,25,6)
    dw  0x4303 ; rgb=(71,96,24)
    dw  0x74c4 ; rgb=(115,154,38)
    dw  0x8dc5 ; rgb=(138,185,46)
    dw  0x9e66 ; rgb=(153,204,51)
    dw  0x2181 ; rgb=(37,49,12)
    dw  0x5bc3 ; rgb=(90,120,29)
    dw  0x0860 ; rgb=(9,12,3)
;
    db  0xf0, 0x07, 0x59, 0x0f, 0x59, 0x0f, 0x59, 0x0f
    db  0x59, 0x0e, 0x20, 0x59, 0x20, 0x0b, 0x60, 0x30
    db  0x5b, 0x30, 0x60, 0x08, 0x20, 0x5f, 0x20, 0x06
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    db  0x70, 0x60, 0x07
