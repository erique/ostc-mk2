dive_trimix_width    equ .78
dive_trimix_height   equ .26
dive_trimix_block:
    db  .39, .26
    db  .12, 0
    dw  0x0000 ; rgb=(0,0,0)
    dw  0x1881 ; rgb=(26,17,8)
    dw  0x3942 ; rgb=(63,41,19)
    dw  0x59e3 ; rgb=(95,60,26)
    dw  0x6a23 ; rgb=(107,68,30)
    dw  0x7264 ; rgb=(117,76,36)
    dw  0x61c2 ; rgb=(96,56,19)
    dw  0xb4f1 ; rgb=(176,157,139)
    dw  0x8349 ; rgb=(134,104,76)
    dw  0xffff ; rgb=(255,255,255)
    dw  0xde98 ; rgb=(217,208,199)
    dw  0xa44e ; rgb=(160,137,115)
;
    db  0xf0, 0x07, 0x59, 0x0f, 0x59, 0x0f, 0x51, 0x65
    db  0x51, 0x0f, 0x51, 0x65, 0x51, 0x0e, 0x10, 0x51
    db  0x65, 0x51, 0x10, 0x0b, 0x10, 0x30, 0x52, 0x65
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    db  0x30, 0x53, 0x30, 0x20, 0x10, 0x07
